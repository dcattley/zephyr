## boards/arm/xlnx_zc706/Kconfig.board
```kconfig
#
# Kconfig - Xilinx ZC706
#
# Copyright (c) 2021, Weidmueller Interface GmbH & Co. KG
# SPDX-License-Identifier: Apache-2.0
#

config BOARD_XLNX_ZC706
	bool "Xilinx ZC706 Board"
	depends on SOC_XILINX_XC7Z045
```

## boards/arm/xlnx_zc706/xlnx_zc706_defconfig
```kconfig
#
# Copyright (c) 2021, Weidmueller Interface GmbH & Co. KG
#
# SPDX-License-Identifier: Apache-2.0
#

CONFIG_BOARD_XLNX_ZC706=y

CONFIG_SOC_SERIES_XILINX_XC7ZXXX=y
CONFIG_SOC_XILINX_XC7Z045=y

CONFIG_ARM_ARCH_TIMER=y

CONFIG_SERIAL=y
CONFIG_CONSOLE=y

CONFIG_ARMV7_EXCEPTION_STACK_SIZE=8192
CONFIG_ARMV7_FIQ_STACK_SIZE=8192
CONFIG_ARMV7_SVC_STACK_SIZE=8192
CONFIG_ARMV7_SYS_STACK_SIZE=8192
CONFIG_IDLE_STACK_SIZE=8192
CONFIG_ISR_STACK_SIZE=8192
CONFIG_MAIN_STACK_SIZE=8192
CONFIG_SYSTEM_WORKQUEUE_STACK_SIZE=8192

# stuff added because ... ?

# enable thread stack info to help with above ...
CONFIG_THREAD_STACK_INFO=y

# enable log
CONFIG_LOG=y
CONFIG_ETHERNET_LOG_LEVEL_DBG=y
CONFIG_NET_STATISTICS=y

# enable debug
#CONFIG_DEBUG=y
```

## boards/arm/xlnx_zcu106_rpu/Kconfig.board
```kconfig
# Copyright (c) 2020, Antmicro
# SPDX-License-Identifier: Apache-2.0
config BOARD_XLNX_ZCU106_RPU
	bool "ZCU106 (RPU) Board"
	depends on SOC_XILINX_ZYNQMP_RPU
```

## boards/arm/xlnx_zcu106_rpu/Kconfig.defconfig
```kconfig
# Copyright (c) 2020, Antmicro
# SPDX-License-Identifier: Apache-2.0

if BOARD_XLNX_ZCU106_RPU

config BUILD_OUTPUT_BIN
	default n

config BOARD
	default "xlnx_zcu106_rpu"

config FLASH_SIZE
	int
	default 64

config FLASH_BASE_ADDRESS
	default 0x08000000

config SYS_CLOCK_HW_CYCLES_PER_SEC
	int
	default 100000000

config SYS_CLOCK_TICKS_PER_SEC
	default 100

if CONSOLE

	config UART_CONSOLE
	default y

endif # CONSOLE

if LOG

	if LOG_PROCESS_THREAD

		config LOG_PROCESS_THREAD_STACK_SIZE
		default 8192

	endif # LOG_PROCESS_THREAD

endif # LOG

if NETWORKING

	config NET_L2_ETHERNET
	default y

	config NET_STATISTICS
	default y

	config NET_TX_STACK_SIZE
	default 8192

	config NET_RX_STACK_SIZE
	default 8192

	if NET_TCP

		config NET_TCP_WORKQ_STACK_SIZE
		default 8192

	endif # NET_TCP

	if NET_MGMT_EVENT

		config NET_MGMT_EVENT_STACK_SIZE
		default 8192

	endif # NET_MGMT_EVENT

	config TEST_RANDOM_GENERATOR
	default y

endif # NETWORKING

if SERIAL

	config UART_XLNX_PS
	default y

endif # SERIAL

if SHELL

	config SHELL_STACK_SIZE
	default 8192

endif # SHELL

endif
```

## boards/arm/xlnx_zcu106_rpu/xlnx_zcu106_rpu_defconfig
```kconfig
# Copyright (c) 2020, Antmicro
CONFIG_SOC_XILINX_ZYNQMP_RPU=y
CONFIG_BOARD_XLNX_ZCU106_RPU=y
CONFIG_XIP=n

CONFIG_SERIAL=y
CONFIG_CONSOLE=y


# ARCH stack sizes.  Possibly excessive.
# Defaults seem to be roughly:
#
#   CONFIG_ARMV7_EXCEPTION_STACK_SIZE=256
#   CONFIG_ARMV7_FIQ_STACK_SIZE=256
#   CONFIG_ARMV7_SVC_STACK_SIZE=512
#   CONFIG_ARMV7_SYS_STACK_SIZE=1024
#
CONFIG_ARMV7_EXCEPTION_STACK_SIZE=8192
CONFIG_ARMV7_FIQ_STACK_SIZE=8192
CONFIG_ARMV7_SVC_STACK_SIZE=8192
CONFIG_ARMV7_SYS_STACK_SIZE=8192

# stuff added because ... ?

# enable thread stack info to help with above ...
CONFIG_THREAD_STACK_INFO=y

# enable MPU
CONFIG_ARM_MPU=y

# enable log
CONFIG_LOG=y
CONFIG_LOG_MODE_IMMEDIATE=y
CONFIG_LOG_BACKEND_UART=y
CONFIG_ETHERNET_LOG_LEVEL_DBG=y

# enable debug
CONFIG_DEBUG=y
```

## boards/arm/zcu106/Kconfig.board
```kconfig
# Copyright (c) 2020, Antmicro
# SPDX-License-Identifier: Apache-2.0
config BOARD_ZCU106
	bool "ZCU106 Board"
	depends on SOC_XILINX_ZYNQMP_RPU
```

## boards/arm/zcu106/Kconfig.defconfig
```kconfig
# Copyright (c) 2020, Antmicro
# SPDX-License-Identifier: Apache-2.0

if BOARD_ZCU106

config BOARD
	default "zcu106"

config FLASH_SIZE
	int
	default 64

config FLASH_BASE_ADDRESS
	default 0x08000000

endif
```
